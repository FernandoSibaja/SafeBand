## firmware/nodo/main/Kconfig.projbuild
```kconfig
menu "SafeBand - Nodo"

    config SAFEBAND_NODO_ID
        string "Código del nodo"
        default "nodo-1"
        help
            Debe coincidir con el campo Codigo de la tabla Nodos.
            Es lo único que cambia entre un nodo y otro (nodo-1, nodo-2...).

    config SAFEBAND_WIFI_SSID
        string "Nombre de la red WiFi (SSID)"
        default ""

    config SAFEBAND_WIFI_PASSWORD
        string "Contraseña del WiFi"
        default ""
        help
            Se guarda solo en sdkconfig, que NO se sube a GitHub (ver firmware/.gitignore).

    config SAFEBAND_API_URL
        string "URL del endpoint de lecturas"
        default "http://192.168.1.50:5213/api/lecturas"
        help
            Local: http://<IP-de-tu-PC>:5213/api/lecturas
            Azure: https://<tu-app>.azurewebsites.net/api/lecturas

    config SAFEBAND_VENTANA_S
        int "Ventana de promedio (segundos)"
        default 10
        range 2 120
        help
            El nodo promedia el RSSI de cada pulsera durante esta ventana y manda
            UNA lectura por pulsera. El SOS se manda de inmediato, sin esperar.

endmenu
```

## firmware/pulsera/main/Kconfig.projbuild
```kconfig
menu "SafeBand - Pulsera"

    config SAFEBAND_PULSERA_ID
        string "Identificador BLE de la pulsera"
        default "SB-0001"
        help
            Nombre que la pulsera anuncia por BLE. Debe existir en la tabla Pulseras
            (campo IdentificadorBle) para que la API acepte sus lecturas.

    config SAFEBAND_REED_NIVEL_PUESTA
        int "Nivel de GPIO4 cuando la pulsera está PUESTA (0 o 1)"
        range 0 1
        default 0
        help
            El reed switch (o un jumper) va de GPIO4 a GND; GPIO4 tiene pull-up interno.
            0 = la pulsera está puesta cuando GPIO4 está en GND (reed normalmente abierto que se
                cierra con el imán del broche, o jumper a GND).
            1 = la pulsera está puesta cuando GPIO4 está en alto.
            Si al acercar el imán el estado sale al revés, cambia este valor.

    config SAFEBAND_MEDIR_BATERIA
        bool "Medir la batería (requiere el divisor de 2 x 100 kOhm en GPIO3)"
        default n
        help
            Lee el voltaje de la LiPo con el ADC en GPIO3 a través de un divisor de voltaje
            (VBAT -- 100k -- GPIO3 -- 100k -- GND). Déjalo apagado mientras el divisor no esté
            conectado: un pin al aire da lecturas al azar y marcaría batería baja sin razón.

    config SAFEBAND_BATERIA_BAJA_MV
        int "Umbral de batería baja (mV)"
        depends on SAFEBAND_MEDIR_BATERIA
        range 3000 4000
        default 3300
        help
            Por debajo de este voltaje se activa el bit de batería baja. Se desactiva
            cuando la batería sube 100 mV por encima (para que no parpadee en el límite).

endmenu
```
